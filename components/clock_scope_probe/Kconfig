## components/clock_scope_probe/Kconfig
```kconfig
menu "Clock scope diagnostic"
config CLOCK_SCOPE_PROBE
    bool "Enable experimental synchronized timing pulses"
    default n
    depends on IDF_TARGET_ESP32P4 || IDF_TARGET_ESP32C6
    help
        Hardware timer pulses on CLOCK_SCOPE_GPIO, once a second on the
        gPTP second.
        Includes scheduling diagnostics; does not enable FTM discipline.
config CLOCK_SCOPE_GPIO
    int "Pulse GPIO"
    depends on CLOCK_SCOPE_PROBE
    default 45 if IDF_TARGET_ESP32P4
    default 18
    help
        GPIO for the once-a-second edge. P4 bridge (Waveshare
        P4-WIFI6-POE-ETH): 45. P4 endpoints (Waveshare ESP32-P4-ETH with
        the hat-trik): a free header pin outside the hat, such as 27.
        Endpoint C6: 18.

config CLOCK_SCOPE_GPIO_LDO4
    bool "Power the pulse GPIO's bank from LDO4 at 3.3 V"
    depends on CLOCK_SCOPE_PROBE && IDF_TARGET_ESP32P4
    default y if CLOCK_SCOPE_GPIO >= 39 && CLOCK_SCOPE_GPIO <= 48
    default n
    help
        GPIO39 to GPIO48 sit in a bank the P4-WIFI6-POE-ETH supplies from
        LDO4. Leave it off for pins outside that bank, and on boards
        whose LDO4 feeds something else.
config CLOCK_SCOPE_HW_PPS
    bool "Use the EMAC's hardware PPS output (P4)"
    depends on CLOCK_SCOPE_PROBE && IDF_TARGET_ESP32P4
    default n
    help
        Routes the EMAC's PPS0 output, driven by the PTP counter itself, to
        CLOCK_SCOPE_GPIO instead of placing timer pulses in software, so
        the edges carry no software placement error. It alternates, on
        gPTP time, between CLOCK_SCOPE_HW_PPS_SLOW_CMD and
        CLOCK_SCOPE_HW_PPS_FAST_CMD every CLOCK_SCOPE_HW_PPS_BLOCK_S
        seconds, so boards on one gPTP domain switch together.

config CLOCK_SCOPE_HW_PPS_SLOW_CMD
    int "PPSCTRL0 value for the slow blocks"
    depends on CLOCK_SCOPE_HW_PPS
    range 0 15
    default 1
    help
        0 gives a narrow 1 PPS pulse. With binary rollover, n gives a
        2^n Hz square wave whose rising edges fall on gPTP time (1: 2 Hz).

config CLOCK_SCOPE_HW_PPS_FAST_CMD
    int "PPSCTRL0 value for the fast blocks"
    depends on CLOCK_SCOPE_HW_PPS
    range 1 15
    default 14
    help
        With binary rollover, a 2^n Hz square wave (14: 16384 Hz).

config CLOCK_SCOPE_HW_PPS_BLOCK_S
    int "Seconds per block"
    depends on CLOCK_SCOPE_HW_PPS
    range 10 86400
    default 600
endmenu
```

## components/ftm_time_engine/Kconfig
```kconfig
menu "FTM time engine"

config FTM_TIME_ENGINE
    bool "Measure gPTP time over FTM as a Wi-Fi coprocessor station"
    depends on HOSTED_AVB_CLOCK_LINK && HOSTED_AVB_BUILD_COPROCESSOR_HANDLER
    default n
    help
        For a Wi-Fi coprocessor that is a station (an endpoint's standby
        link). While associated, it asks the access point for a PTP
        compatible FTM burst every 125 ms, reads gPTP time from the
        Follow_Up the responder puts in each frame, and sends the host
        gPTP time against the clock link's timer. Needs
        CONFIG_ESP_WIFI_ENABLE_FTM_PTP (Espressif's PTP compatible FTM)
        and a responder that fills the Follow_Up. Enable
        HOSTED_AVB_WIFI_TIME on the host.

config FTM_TIME_ENGINE_KEEP_CADENCE
    bool "Keep to the session cadence after slow sessions"
    depends on FTM_TIME_ENGINE
    default y
    help
        Starts the next session no sooner than 125 ms on, however far
        behind the schedule slow sessions left it. Off, sessions that
        failed after about 1.4 s each left the schedule hours behind,
        and the engine then asked for FTM back to back to catch up:
        37 sessions a second for 25 minutes. Bench-tested 11-23: 8 a
        second straight after a 5 minute backlog.

config FTM_TIME_ENGINE_DROP_ACROSS_STEP
    bool "Drop a single measurement taken across a responder clock step"
    depends on FTM_TIME_ENGINE
    default y
    help
        A session with one usable measurement takes the responder's rate
        from the previous session. A rate more than 1000 ppm off means
        the responder's clock stepped in between; the measurement is
        then dropped and the session becomes the next one's anchor.
        Off, the measurement is used with the last good rate: one taken
        across a 250 us step went through 250 us wrong.

endmenu
```

## components/ftm_time_responder/Kconfig
```kconfig
menu "FTM time responder"

config FTM_TIME_RESPONDER
    bool "Put a gPTP Follow_Up in every FTM frame (bridge)"
    depends on HOSTED_AVB_CLOCK_LINK && !FTM_CLOCK_PROBE
    default n
    help
        The access point side of 802.1AS FTM time transfer: the
        coprocessor, the FTM responder, puts a Follow_Up in every FTM frame
        it sends a station esp_ptp has admitted, giving gPTP time at that
        frame's measurement. The host feeds it gPTP time on the
        coprocessor's clock-link timer every 200 ms. Enable on both the
        bridge and its coprocessor, with HOSTED_AVB_CLOCK_LINK on both;
        the coprocessor also needs CONFIG_ESP_WIFI_ENABLE_FTM_PTP
        (Espressif's PTP compatible FTM). The bridge logs the
        coprocessor's counts every 10 s (FTMRESP lines).

config BEACON_TIME_FROM_LINK
    bool "Fill the beacon time element for one instant (bridge)"
    depends on HOSTED_AVB_CLOCK_LINK
    default n
    help
        The coprocessor writes gPTP time at the very AP TSF the beacon
        time element carries, from the host's gPTP time on its clock-link
        timer, and the rate of gPTP time against the TSF in the element's
        cumulativeScaledRateOffset. Without it the host stamps the element
        and the coprocessor adds the TSF a host message later, with a
        rate of 0, and stations follow it through a slow envelope. Enable
        on both the bridge and its coprocessor, with HOSTED_AVB_CLOCK_LINK
        on both. The coprocessor logs BEACONTIME lines every 10 s.

config BEACON_TIME_OFFSET_NS
    int "Added to the beacon element's gPTP time (ns)"
    depends on BEACON_TIME_FROM_LINK
    range -1000000 1000000
    default 64000
    help
        A constant the filled element's gPTP time is advanced by. Without
        it a station behind esp-ap ran 64 us behind wired gPTP on the
        scope (11-23, sd 1.9 us over 27 min): the latency between the
        AP TSF read here and the TSF the station takes the time against.

config FTM_TIME_TRANSFER
    bool
    default y if FTM_TIME_RESPONDER || BEACON_TIME_FROM_LINK

endmenu
```
